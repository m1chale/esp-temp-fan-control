## main/Kconfig.projbuild
```kconfig
menu "Custom Configuration"

config DHT_GPIO
    int "DHT GPIO"
    default 16

config WIFI_SSID
    string "WiFi SSID"
    default "your-ssid"

config WIFI_PASS
    string "WiFi Password"
    default "your-password"

config MQTT_URI
    string "MQTT URI"
    default "mqtt://1.1.1.1"

config MQTT_USERNAME
    string "MQTT Username"
    default "mqtt-user"

config MQTT_PASSWORD
    string "MQTT Password"
    default "mqtt-pass"

endmenu
```

## sdkconfig.defaults
```kconfig
CONFIG_PWM_GPIO=18
CONFIG_DHT_GPIO=16
CONFIG_WIFI_SSID="your-ssid"
CONFIG_WIFI_PASS="your-password"
CONFIG_MQTT_URI="mqtt://1.1.1.1"
CONFIG_MQTT_USERNAME="mqtt-user"
CONFIG_MQTT_PASSWORD="mqtt-pass"
```
